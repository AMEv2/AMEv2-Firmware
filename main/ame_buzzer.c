 /*********************************************************************************************************************
 * Filename  : ame_buzzer.c
 * Author    : ChristiaanAlberts
 * Created on: 07 June 2024
  ********************************************************************************************************************/
/*********************************************************************************************************************
 * @file   	ame_buzzer.c
 * @brief  	AME Buzzer task
 *
 *********************************************************************************************************************/

/**********************************************************************************************************************
* Includes
**********************************************************************************************************************/
#include <stdint.h>
#include <stdlib.h>
#include <string.h>

#include "freertos/FreeRTOS.h"
#include "freertos/task.h"
#include "esp_timer.h"
#include "esp_log.h"

#include "rtttl.h"
#include "ame_cfg.h"
#include "ame_buzzer.h"

 static const char *TAG = "ame_buzzer";

 /**********************************************************************************************************************
  * Module Preprocessor Constants
  **********************************************************************************************************************/

 /**********************************************************************************************************************
  * Module Preprocessor Macros
  **********************************************************************************************************************/
#define NUM_TUNES (sizeof(tunes) / sizeof(tunes[0]))

 /**********************************************************************************************************************
  * Module Typedefs
  **********************************************************************************************************************/

 /**********************************************************************************************************************
  * Module Variable Definitions
  **********************************************************************************************************************/
 static const char *tunes[] = {
     "None:d=32,o=5,b=100:p",
     "ScaleUp:d=32,o=5,b=100:c,c#,d#,e,f#,g#,a#,b",
     "6Million:d=16,o=6,b=80:c#.,f#.,b.,4g#.,a.,g#.,e.,d.,b.5,c#.,e.,d#.,2c#,p,4b5,c#.,f#.,b.,4g#.,a.,g#.,e.,d.,b.5,c#.,e.,d#.,2c#,32f#5,32g#5,32a5,32b5,32c#,32d,32e,32f,4f#,c#,p,b5,p,e5,4f#5",
     "AdamsFamily:d=4,o=5,b=160:8c,f,8a,f,8c,b4,2g,8f,e,8g,e,8e4,a4,2f,8c,f,8a,f,8c,b4,2g,8f,e,8c,d,8e,1f,8c,8d,8e,8f,1p,8d,8e,8f#,8g,1p,8d,8e,8f#,8g,p,8d,8e,8f#,8g,p,8c,8d,8e,8f",
     "A-Team:d=8,o=5,b=125:4d#6,a#,2d#6,16p,g#,4a#,4d#.,p,16g,16a#,d#6,a#,f6,2d#6,16p,c#.6,16c6,16a#,g#.,2a#",
     "AirWolf:d=4,o=6,b=100:e5,16a5,16b5,16d,e,16g,16f_,16d,e,16g,16f_,16d,e,8d,16f_,b5,a5,8g5,16a5,8f_5,16d5,g5,16c,16d,16f,g,16c,16b,16f,g,16c,16b,16f,g,8f,16a,d,c,8b5,16d,8a5,16f5,g5,16c,16d,16f,g,16c,16b,16f",
     "Blue:b=128,o=5,d=1:4a,8a#,8d,8g,8a#,8c6,8f,8a,4a#,8g,8a#,8d6,8d#6,8g,8d6,8c6,8a#,8d,8g,8a#,8a,8c,8f,4g.",
     "Bond:d=4,o=5,b=80:32p,16c#6,32d#6,32d#6,16d#6,8d#6,16c#6,16c#6,16c#6,16c#6,32e6,32e6,16e6,8e6,16d#6,16d#6,16d#6,16c#6,32d#6,32d#6,16d#6,8d#6,16c#6,16c#6,16c#6,16c#6,32e6,32e6,16e6,8e6,16d#6,16d6,16c#6,16c#7,c.7,16g#6,16f#6,g#.6",
     "DireStraits:d=4,o=5,b=160:g#.,g#.,p,8p,8f#,8g#,b,8g#,f#,e.,e.,p,2p,p,8f#,8g#,b.,b.,p,8p,8f#,8g#,b,8g#,8f#,e.,e.",
     "Entertainer:d=4,o=5,b=140:8d,8d#,8e,c6,8e,c6,8e,2c.6,8c6,8d6,8d#6,8e6,8c6,8d6,e6,8b,d6,2c6,p,8d,8d#,8e,c6,8e,c6,8e,2c.6,8p,8a,8g,8f#,8a,8c6,e6,8d6,8c6,8a,2d6",
     "Flinstones:d=4,o=5,b=40:32p,16f6,16a#,16a#6,32g6,16f6,16a#.,16f6,32d#6,32d6,32d6,32d#6,32f6,16a#,16c6,d6,16f6,16a#.,16a#6,32g6,16f6,16a#.,32f6,32f6,32d#6,32d6,32d6,32d#6,32f6,16a#,16c6,a#,16a6,16d.6,16a#6,32a6,32a6,32g6,32f#6,32a6,8g6,16g6,16c.6,32a6,32a6,32g6,32g6,32f6,32e6,32g6,8f6,16f6,16a#.,16a#6,32g6,16f6,16a#.,16f6,32d#6,32d6,32d6,32d#6,32f6,16a#,16c.6,32d6,32d#6,32f6,16a#,16c.6,32d6,32d#6,32f6,16a#6,16c7,8a#.6",
     "GoodBad:d=4,o=5,b=56:32p,32a#,32d#6,32a#,32d#6,8a#.,16f#.,16g#.,d#,32a#,32d#6,32a#,32d#6,8a#.,16f#.,16g#.,c#6,32a#,32d#6,32a#,32d#6,8a#.,16f#.,32f.,32d#.,c#,32a#,32d#6,32a#,32d#6,8a#.,16g#.,d#",
     "GranVals:d=4,o=5,b=225:8e6,8d6,f#,g#,8c#6,8b,d,e,8b,8a,c#,e,2e.",
     "ImperialMarch1:d=4,o=3,b=450:2g5,2p,2g5,2p,2g5,2p,2d#5,4p,4a#5,2g5,2p,2d#5,4p,4a#5,1g5,2p",
     "ImperialMarch2:o=5,d=4,b=120:e,e,e,8c,16p,16g,e,8c,16p,16g,e,p,b,b,b,8c6,16p,16g,d#,8c,16p,16g,e,8",
     "Indiana:d=4,o=5,b=250:e,8p,8f,8g,8p,1c6,8p.,d,8p,8e,1f,p.,g,8p,8a,8b,8p,1f6,p,a,8p,8b,2c6,2d6,2e6,e,8p,8f,8g,8p,1c6,p,d6,8p,8e6,1f.6,g,8p,8g,e.6,8p,d6,8p,8g,e.6,8p,d6,8p,8g,f.6,8p,e6,8p,8d6,2c6",
     "Jeopardy:d=4,o=6,b=125:c,f,c,f5,c,f,2c,c,f,c,f,a.,8g,8f,8e,8d,8c#,c,f,c,f5,c,f,2c,f.,8d,c,a#5,a5,g5,f5,p,d#,g#,d#,g#5,d#,g#,2d#,d#,g#,d#,g#,c.7,8a#,8g#,8g,8f,8e,d#,g#,d#,g#5,d#,g#,2d#,g#.,8f,d#,c#,c,p,a#5,p,g#.5,d#,g#",
     "KnightRider:d=4,o=5,b=125:16e,16p,16f,16e,16e,16p,16e,16e,16f,16e,16e,16e,16d#,16e,16e,16e,16e,16p,16f,16e,16e,16p,16f,16e,16f,16e,16e,16e,16d#,16e,16e,16e,16d,16p,16e,16d,16d,16p,16e,16d,16e,16d,16d,16d,16c,16d,16d,16d,16d,16p,16e,16d,16d,16p,16e,16d,16e,16d,16d,16d,16c,16d,16d,16d",
     "Kyle'sMo:d=16,o=5,b=160:2c6,8f,f,f,8f,c,c,f,f,8f,8f,c,c,f,f,8f,8g,f,f,8f,8e,8e,8c,8e,e,e,8e,c,c,e,e,8e,8e,d,d,8c,c,c,8d,e,e,8g,8f,8f",
     "Looney:d=4,o=5,b=140:32p,c6,8f6,8e6,8d6,8c6,a.,8c6,8f6,8e6,8d6,8d#6,e.6,8e6,8e6,8c6,8d6,8c6,8e6,8c6,8d6,8a,8c6,8g,8a#,8a,8f",
     "MacGyver:d=4,o=5,b=160:8c6,8c6,8c6,8c6,8c6,8c6,2b,8f#,8a,8p,2g,8c6,8c6,8p,b,8a,8b,8a,8g,8p,e6,a.,16p,b.,16p,c6,8b,8a,c6",
     "MissionImp:d=16,o=6,b=95:32d,32d#,32d,32d#,32d,32d#,32d,32d#,32d,32d,32d#,32e,32f,32f#,32g,g,8p,g,8p,a#,p,c7,p,g,8p,g,8p,f,p,f#,p,g,8p,g,8p,a#,p,c7,p,g,8p,g,8p,f,p,f#,p,a#,g,2d,32p,a#,g,2c#,32p,a#,g,2c,a#5,8c",
     "Mario PowerUp:d=2,o=2,b=820:8c5,8g4,8c5,8e5,8g5,8c6,8g5,8g#4,8c5,8d#5,8g#5,8d#5,8g#5,8c6,8d#6,8g#6,8d#6,8d5,8f5,8a#5,8f5,8a#5,8d6,8f6,8d6,8f6,8a#6,8f6",
     "SuperMarioBros Intro:b=115,o=5,d=4:16e6,32p, 16e6,16p,16e6,16p,16c6,16e6,16p,16g6,8p,16p,16g5,2p",
     "PinkPanther:d=4,o=5,b=100:p,16d#4,e4,8p,16f#4,g4,16p,16d#4,8e4,64p,16f#4,8g4,64p,16c5,8b4,64p,16e4,8g4,64p,16b4,2a#4,16a4,16g4,16e4,16d4,e4,16p",
     "Pacman:d=32,o=5,b=112:c#,p,c#6,p,g#,p,f,p,c#6,g#,16p,16f.,p,d,p,d6,p,a,p,f#,p,d6,a,16p,16f#.,p,c#,p,c#6,p,g#,p,f,p,c#6,g#,16p,16f.,p,e,f,f#,p,f#,g,g#,p,g#,a,a#,p,16c#6",
     "Police:d=4,o=6,b=140:8e,8c,8e,8c,8e,8c,8e,8c,8e,8c,8e,8c,8e,8c,8e,8c,8e,8c,8e,8c,8e,8c,8e,8c",
     "Simpsons:d=4,o=5,b=160:c.6,e6,f#6,8a6,g.6,e6,c6,8a,8f#,8f#,8f#,2g,8p,8p,8f#,8f#,8f#,8g,a#.,8c6,8c6,8c6,c6",
     "StarWars:d=4,o=5,b=45:32p,32f#,32f#,32f#,8b.,8f#.6,32e6,32d#6,32c#6,8b.6,16f#.6,32e6,32d#6,32c#6,8b.6,16f#.6,32e6,32d#6,32e6,8c#.6,32f#,32f#,32f#,8b.,8f#.6,32e6,32d#6,32c#6,8b.6,16f#.6,32e6,32d#6,32c#6,8b.6,16f#.6,32e6,32d#6,32e6,8c#6",
     "TopGun:d=4,o=4,b=31:32p,16c#,16g#,16g#,32f#,32f,32f#,32f,16d#,16d#,32c#,32d#,16f,32d#,32f,16f#,32f,32c#,16f,d#,16c#,16g#,16g#,32f#,32f,32f#,32f,16d#,16d#,32c#,32d#,16f,32d#,32f,16f#,32f,32c#,g#",
     "X-files1:d=4,o=5,b=112:16c,16d#,16g,8g#,2p,8p,c,c,c,c,g,f,g,a#,16g,16d#,16g,8g#,2p,p,2d.6,d#6,d6,c6,a#,d6,2g.,d#6,d6,c6,a#,d6,1g,16c,16d#,16g,8g#,2p,p,c,c,c",
     "X-files2:d=4,o=5,b=125:e,b,a,b,d6,2b.,1p,e,b,a,b,e6,2b.,1p,g6,f#6,e6,d6,e6,2b.,1p,g6,f#6,e6,d6,f#6,2b.,1p,e,b,a,b,d6,2b.,1p,e,b,a,b,e6,2b.,1p,e6,2b."};

 /**********************************************************************************************************************
  * Global Variable Definitions
  **********************************************************************************************************************/

 /**********************************************************************************************************************
  * Module Function Prototypes
  **********************************************************************************************************************/

 /**********************************************************************************************************************
  * Global Function Definitions
  **********************************************************************************************************************/
 void AME_BUZZER_Task(void *arg)
 {
     char tuneName[32];
     RTTTL_Init();

     int startupTune = AME_CFG_GetStartupTune();
     if (startupTune > NUM_TUNES)
     {
         startupTune = 0;
     }

     AME_BUZZER_GetTuneName(startupTune, tuneName, sizeof(tuneName));
     ESP_LOGI(TAG, "Playing tune: %s @ volume: %d", tuneName, AME_CFG_GetStartupTuneVol());
     RTTTL_PlayTune(tunes[startupTune], AME_CFG_GetStartupTuneVol());

     for (;;)
     {
         vTaskDelay(portMAX_DELAY);
     }
}

uint8_t AME_BUZZER_GetTuneCount(void)
{
    return NUM_TUNES;
}

void AME_BUZZER_GetTuneName(uint8_t selectedTune, char *tempStr, uint8_t maxLen)
{
    //return first part of tunes string before the colon
    char *ret;

    memset(tempStr, 0, maxLen);
    ret = strchr(tunes[selectedTune], ':');
    ESP_LOGI(TAG, "selected tune: %d, ret: %s", selectedTune, ret);

    if (ret != NULL)
    {
        uint8_t len = ret - tunes[selectedTune];
        if ((tunes[selectedTune] - ret) > maxLen)
        {
            len = maxLen;
        }
        strncpy(tempStr, tunes[selectedTune], len);
    }
}

/**********************************************************************************************************************
* Module Function Definitions
**********************************************************************************************************************/


/*************** END OF FUNCTIONS ************************************************************************************/
