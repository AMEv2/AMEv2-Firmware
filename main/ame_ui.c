 /*********************************************************************************************************************
 * Filename  : ui.c
 * Author    : ChristiaanAlberts
 * Created on: 24 March 2024
  ********************************************************************************************************************/
/*********************************************************************************************************************
 * @file   	ui.c
 * @brief  	Drop servo task
 *
 *********************************************************************************************************************/

/**********************************************************************************************************************
* Includes
**********************************************************************************************************************/
#include <stdint.h>
#include <stdlib.h>
#include <string.h>
#include <inttypes.h>

#include "freertos/FreeRTOS.h"
#include "freertos/task.h"
#include "driver/gpio.h"
#include "esp_timer.h"
#include "esp_log.h"
#include "esp_netif.h"
#include "esp_app_desc.h"

#include "u8g2.h"
#include "u8g2_esp32_hal.h"

#include "encoder.h"
#include "pubsub.h"
#include "ame_cfg.h"
#include "ota_task.h"
#include "ame_anneal.h"
#include "ame_stepper.h"
#include "ame_buzzer.h"

static const char *TAG = "gui";

/**********************************************************************************************************************
 * Module Preprocessor Constants
 **********************************************************************************************************************/
#define RE_A_GPIO 36
#define RE_B_GPIO 39
#define RE_BTN_GPIO 12
#define RE_VDD_GPIO 15
#define RE_GND_GPIO 5

#define EV_QUEUE_LEN 5

/**********************************************************************************************************************
 * Module Preprocessor Macros
 **********************************************************************************************************************/
#define NUM_MENU_ITEMS (8)

/**********************************************************************************************************************
 * Module Typedefs
 **********************************************************************************************************************/

/**********************************************************************************************************************
 * Module Variable Definitions
 **********************************************************************************************************************/
static u8g2_t u8g2; // a structure which will contain all the data for one display
static uint32_t displayWidth = 128;

static float temperature = 0.0;
static float current = 0.0;

static int16_t casesCount = 0;
static uint16_t casesRemaining = 0;
static uint16_t casesTotal = 100;
static int32_t caseHeight = 30000;
static uint16_t feederSpeed = 5;
static char infoMessage[20];

static QueueHandle_t event_queue;
static rotary_encoder_t re;

static uint16_t time_ms = 2100;

static uint32_t buttonPressedTimestamp = 0;

static int8_t menuIdx = 0;
static const char *menuItems[NUM_MENU_ITEMS] = {"Time", "Height", "Count", "Speed", "Volume", "Info", "Wi-Fi", "Back"};

static rotary_encoder_event_t e;

// 'AmeSplash', 96x34px
const unsigned char epd_bitmap_AmeSplash[] = {
    0x00, 0x00, 0x00, 0x00, 0x00, 0x00, 0x00, 0x00, 0x00, 0x00, 0x00, 0x00, 0x00, 0x00, 0x00, 0x00,
    0x00, 0x00, 0x00, 0x00, 0x00, 0x00, 0x00, 0x00, 0x00, 0x00, 0x00, 0x00, 0x00, 0x00, 0x00, 0x00,
    0x00, 0x00, 0x00, 0x00, 0x00, 0x00, 0x00, 0x00, 0x00, 0x00, 0x00, 0x00, 0x00, 0x00, 0x00, 0x00,
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    0x00, 0x00, 0x00, 0x00, 0x00, 0x00, 0x00, 0x00};

#define FRAME_DELAY (42)
#define FRAME_WIDTH (64)
#define FRAME_HEIGHT (64)
#define FRAME_COUNT (sizeof(startAnimation) / sizeof(startAnimation[0]))
const uint8_t startAnimation[][512] = {
    {0, 0, 0, 0, 0, 0, 0, 0, 0, 0, 0, 0, 0,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 0, 0},
    {0, 0, 0, 0, 0, 0, 0, 0, 0, 0, 0, 0, 0,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 0, 0},
    {0, 0, 0, 0, 0, 0, 0, 0, 0, 0, 0, 0, 0,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 0, 0},
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    {0, 0, 0, 0, 0, 0, 0, 0, 0, 0, 0, 0, 0,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 0, 0}};

/**********************************************************************************************************************
 * Global Variable Definitions
 **********************************************************************************************************************/
extern TaskHandle_t s_ota_task_handle;
extern TaskHandle_t s_display_task_handle;

/**********************************************************************************************************************
 * Module Function Prototypes
 **********************************************************************************************************************/
static void ame_ui_DrawVersion(void);
static void ame_ui_UpdateHomeScreen(void);
static void ame_ui_Menu(void);
static void ame_ui_DrawMenuItem(uint8_t menuIdx);
static void ame_ui_MenuItemSelected(int8_t menuIdx);

static void ame_ui_MenuItemTime(void);
static void ame_ui_MenuItemHeight(void);
static void ame_ui_MenuItemCount(void);
static void ame_ui_MenuItemSpeed(void);
static void ame_ui_MenuItemVolume(void);
static void ame_ui_MenuItemOta(void);
static void ame_ui_MenuItemInfo(void);
static void ame_ui_TuneSelection(void);

static bool ame_ui_ShowStartAnimantion(void);
static void gpio_isr_handler(void *arg);

/**********************************************************************************************************************
 * Global Function Definitions
 **********************************************************************************************************************/
void AME_UI_Task(void *pvArgs)
{
    gpio_reset_pin(CONFIG_IO_PIN_START_STOP_SWITCH);
    // zero-initialize the config structure.
    gpio_config_t io_conf = {};
    // disable interrupt
    io_conf.intr_type = GPIO_INTR_NEGEDGE;
    // set as output mode
    io_conf.mode = GPIO_MODE_INPUT;
    // bit mask of the pins that you want to set,e.g.GPIO18/19
    io_conf.pin_bit_mask = 1ULL << CONFIG_IO_PIN_START_STOP_SWITCH;
    // disable pull-down mode
    io_conf.pull_down_en = 0;
    // disable pull-up mode
    io_conf.pull_up_en = 1;
    // configure GPIO with the given settings
    gpio_config(&io_conf);

    // install gpio isr service
    gpio_install_isr_service(0);
    // hook isr handler for specific gpio pin
    gpio_isr_handler_add(CONFIG_IO_PIN_START_STOP_SWITCH, gpio_isr_handler, (void *)CONFIG_IO_PIN_START_STOP_SWITCH);
    // hook isr handler for specific gpio pin

    // Create event queue for rotary encoders
    event_queue = xQueueCreate(EV_QUEUE_LEN, sizeof(rotary_encoder_event_t));

    // Setup rotary encoder library
    ESP_ERROR_CHECK(rotary_encoder_init(event_queue));

    // Add one encoder
    memset(&re, 0, sizeof(rotary_encoder_t));
    re.pin_a = CONFIG_IO_PIN_ROT_A;
    re.pin_b = CONFIG_IO_PIN_ROT_B;
    re.pin_btn = CONFIG_IO_PIN_ROT_SW;
    ESP_ERROR_CHECK(rotary_encoder_add(&re));

    int32_t val = 0;

    ESP_LOGI(TAG, "Initial value: %" PRIi32, val);

    // esp_log_level_set("u8g2_hal", ESP_LOG_ERROR);
    u8g2_esp32_hal_t u8g2_esp32_hal = U8G2_ESP32_HAL_DEFAULT;
#ifdef CONFIG_LCD_TYPE_SPI
    u8g2_esp32_hal.bus.spi.clk = CONFIG_IO_PIN_SPI_CLK;
    u8g2_esp32_hal.bus.spi.mosi = CONFIG_IO_PIN_SPI_MOSI;
    u8g2_esp32_hal.bus.spi.cs = CONFIG_IO_PIN_SPI_CS;
#else
    u8g2_esp32_hal.bus.i2c.sda = CONFIG_IO_PIN_I2C_SDA;
    u8g2_esp32_hal.bus.i2c.scl = CONFIG_IO_PIN_I2C_SCL;
#endif
    u8g2_esp32_hal_init(u8g2_esp32_hal);

    u8g2_Setup_ssd1306_i2c_128x64_noname_f(
        &u8g2,
        U8G2_R0,
        // u8x8_byte_sw_i2c,
        u8g2_esp32_i2c_byte_cb,
        u8g2_esp32_gpio_and_delay_cb); // init u8g2 structure
    u8x8_SetI2CAddress(&u8g2.u8x8, 0x78);

    ESP_LOGI(TAG, "u8g2_InitDisplay");
    u8g2_InitDisplay(&u8g2); // send init sequence to the display, display is in sleep mode after this,

    ESP_LOGI(TAG, "u8g2_SetPowerSave");
    u8g2_SetPowerSave(&u8g2, 0); // wake up display

    displayWidth = u8g2_GetDisplayWidth(&u8g2);
    u8g2_SetContrast(&u8g2, 255);

    ame_ui_DrawVersion();
    vTaskDelay(pdMS_TO_TICKS(2000));

    time_ms = AME_CFG_GetTime();
    if (time_ms > 30000)
    {
        time_ms = 2100;
        AME_CFG_SetTime(2100);
    }
    else if (time_ms < 100)
    {
        time_ms = 100;
        AME_CFG_SetTime(100);
    }

    casesTotal = AME_CFG_GetCasesCount();
    {
        if (casesTotal > 1000)
        {
            casesTotal = 1000;
            AME_CFG_SetCasesCount(1000);
        }
    }

    caseHeight = AME_CFG_GetHeight();

    ps_subscriber_t *subTemp = ps_new_subscriber(1, STRLIST("ame.sensor.temp.1"));
    ps_subscriber_t *subCurr = ps_new_subscriber(1, STRLIST("ame.sensor.current"));
    ps_subscriber_t *subTime = ps_new_subscriber(1, STRLIST("ame.anneal.time"));
    ps_subscriber_t *subDone = ps_new_subscriber(1, STRLIST("ame.anneal.casesDone"));
    ps_subscriber_t *subRemain = ps_new_subscriber(1, STRLIST("ame.anneal.casesRemain"));
    ps_subscriber_t *subMessage = ps_new_subscriber(1, STRLIST("ame.gui.message"));
    ps_msg_t *msg = NULL;

    for (;;)
    {
        ame_ui_UpdateHomeScreen();

        if (xQueueReceive(event_queue, &e, pdMS_TO_TICKS(10)) == pdPASS)
        {
            if (e.type == RE_ET_BTN_CLICKED)
            {
                if (AME_ANNEAL_IsAnnealing() == false)
                {
                    ame_ui_Menu();
                }
                else
                {
                    // Already annealing, so stop annealing
                    AME_ANNEAL_Stop();
                }
            }
            else if (e.type == RE_ET_CHANGED)
            {
            }
        }

        if (xTaskNotifyWait(0, ULONG_MAX, NULL, pdMS_TO_TICKS(10)) == pdTRUE)
        {
            if (esp_log_timestamp() - buttonPressedTimestamp > 500)
            {
                if (gpio_get_level(CONFIG_IO_PIN_START_STOP_SWITCH) == 0)
                {
                    // Start stop button pressed
                    if (AME_ANNEAL_IsAnnealing() == false)
                    {
                        // Not yet annealing, so show startup animation
                        if (ame_ui_ShowStartAnimantion() == true)
                        {
                            // Button held long enough to start annealing
                            AME_ANNEAL_Start();
                            buttonPressedTimestamp = esp_log_timestamp();
                        }
                    }
                    else
                    {
                        // Already annealing, so stop annealing
                        AME_ANNEAL_Stop();
                    }
                }
            }
        }

        msg = ps_get(subTemp, 0);
        if (msg != NULL)
        {
            if (PS_IS_DBL(msg))
            {
                temperature = msg->dbl_val;
            }
        }
        ps_unref_msg(msg);

        msg = ps_get(subCurr, 0);
        if (msg != NULL)
        {
            if (PS_IS_DBL(msg))
            {
                current = msg->dbl_val;
            }
        }
        ps_unref_msg(msg);

        msg = ps_get(subTime, 0);
        if (msg != NULL)
        {
            if (PS_IS_INT(msg))
            {
                time_ms = msg->int_val;
            }
        }
        ps_unref_msg(msg);

        msg = ps_get(subDone, 0);
        if (msg != NULL)
        {
            if (PS_IS_INT(msg))
            {
                casesCount = msg->int_val;
            }
        }
        ps_unref_msg(msg);

        msg = ps_get(subRemain, 0);
        if (msg != NULL)
        {
            if (PS_IS_INT(msg))
            {
                casesRemaining = msg->int_val;
            }
        }
        ps_unref_msg(msg);

        msg = ps_get(subMessage, 0);
        if (msg != NULL)
        {
            if (PS_IS_STR(msg))
            {
                strcpy(infoMessage, msg->str_val);
            }
        }
        ps_unref_msg(msg);
    }
}

/**********************************************************************************************************************
* Module Function Definitions
**********************************************************************************************************************/
// Display version
static void ame_ui_DrawVersion(void)
{
    const esp_app_desc_t *app_desc = esp_app_get_description();

    u8g2_ClearBuffer(&u8g2);
    u8g2_DrawBitmap(&u8g2, 16, 0, 96/8, 30, epd_bitmap_AmeSplash);
    u8g2_SetFont(&u8g2, u8g2_font_ncenB08_tr);
    char tempStr[40] = {0};
    snprintf(tempStr, sizeof(tempStr), "Ver: %s", app_desc->version);
    uint8_t width = u8g2_GetUTF8Width(&u8g2, tempStr);
    u8g2_DrawStr(&u8g2, (displayWidth - width) / 2, 40, tempStr);
    snprintf(tempStr, sizeof(tempStr), "S/N: %05"PRIu32, AME_CFG_GetSerialNumber());
    width = u8g2_GetUTF8Width(&u8g2, tempStr);
    u8g2_DrawStr(&u8g2, (displayWidth - width) / 2, 55, tempStr);
    u8g2_SendBuffer(&u8g2);
}

static void ame_ui_UpdateHomeScreen(void)
{
    char tempStr[20];
    u8g2_ClearBuffer(&u8g2);

    // Time remaining
    u8g2_SetFont(&u8g2, u8g2_font_ncenB24_tr);
    sprintf(tempStr, "%.2fs", ((float)time_ms)/1000.0f);
    uint8_t width = u8g2_GetUTF8Width(&u8g2, tempStr);
    u8g2_DrawStr(&u8g2, (displayWidth - width) / 2, 30, tempStr);

    // Mode/info
    u8g2_SetFont(&u8g2, u8g2_font_ncenB08_tr);
    u8g2_DrawStr(&u8g2, 2, 45, infoMessage);

    // cases done, remaining and total
    sprintf(tempStr, "%d/%d/%d", casesCount, casesRemaining, casesTotal);
    width = u8g2_GetUTF8Width(&u8g2, tempStr);
    u8g2_DrawStr(&u8g2, (displayWidth - width), 45, tempStr);

    // Temperature
    sprintf(tempStr, "%.2f C", temperature);
    u8g2_DrawStr(&u8g2, 2, 60, tempStr);

    // Current draw
    sprintf(tempStr, "%.2f A", current);
    width = u8g2_GetUTF8Width(&u8g2, tempStr);
    u8g2_DrawStr(&u8g2, (displayWidth - width), 60, tempStr);

    u8g2_SendBuffer(&u8g2);
}

static void ame_ui_Menu(void)
{
    // Menu Entered
    ESP_LOGI(TAG, "Button pressed");
    // Draw First menu item
    menuIdx = 0;
    ame_ui_DrawMenuItem(menuIdx);

    for (;;)
    {
        if (xQueueReceive(event_queue, &e, pdMS_TO_TICKS(20000)) == pdPASS)
        {
            if (e.type == RE_ET_BTN_CLICKED)
            {
                // Menu Entered
                ESP_LOGI(TAG, "Menu Item %d selected", menuIdx);
                if (menuIdx == NUM_MENU_ITEMS - 1)
                {
                    // Back
                    ESP_LOGI(TAG, "Back - Exit Menu");
                    break;
                }
                else
                {
                    ame_ui_MenuItemSelected(menuIdx);
                }
            }
            else if (e.type == RE_ET_CHANGED)
            {
                // next menu item
                if (e.diff > 0)
                {
                    // next menu item
                    menuIdx++;
                    if (menuIdx >= NUM_MENU_ITEMS)
                    {
                        menuIdx = NUM_MENU_ITEMS - 1;
                    }
                    ame_ui_DrawMenuItem(menuIdx);
                }
                else if (e.diff < 0)
                {
                    // prev menu item
                    menuIdx--;
                    if (menuIdx < 0)
                    {
                        menuIdx = 0;
                    }
                    ame_ui_DrawMenuItem(menuIdx);
                }
            }
            else if (e.type == RE_ET_BTN_LONG_PRESSED)
            {
                // Long pressed, exit menu
                break;
            }
        }
        else
        {
            // timed out
            ESP_LOGI(TAG, "Menu Timed Out");
            break;
        }
    }
}

static void ame_ui_DrawMenuItem(uint8_t menuIdx)
{
    u8g2_ClearBuffer(&u8g2);
    u8g2_SetFont(&u8g2, u8g2_font_ncenB18_tr);
    uint8_t width = u8g2_GetUTF8Width(&u8g2, menuItems[menuIdx]);
    u8g2_DrawStr(&u8g2, (displayWidth - width)/2, 35, menuItems[menuIdx]);
    u8g2_SendBuffer(&u8g2);
}

static void ame_ui_MenuItemSelected(int8_t menuIdx)
{
    switch(menuIdx)
    {
        case 0:
        {
            // Time
            ame_ui_MenuItemTime();
            break;
        }

        case 1:
        {
            // Height
            ame_ui_MenuItemHeight();
            break;
        }

        case 2:
        {
            // Count
            ame_ui_MenuItemCount();
            break;
        }

        case 3:
        {
            // Speed
            ame_ui_MenuItemSpeed();
            break;
        }

        case 4:
        {
            // Volume
            ame_ui_MenuItemVolume();
            break;
        }

        case 5:
        {
            // Info
            ame_ui_MenuItemInfo();
            break;
        }

        case 6:
        {
            // OTA
            ame_ui_MenuItemOta();
            break;
        }
    }
}

static void ame_ui_MenuItemTime(void)
{
    char tempStr[20];

    for(;;)
    {
        u8g2_ClearBuffer(&u8g2);
        u8g2_SetFont(&u8g2, u8g2_font_ncenB12_tr);
        uint8_t width = u8g2_GetUTF8Width(&u8g2, menuItems[0]);
        u8g2_DrawStr(&u8g2, (displayWidth - width) / 2, 20, menuItems[0]);
        u8g2_SetFont(&u8g2, u8g2_font_ncenB24_tr);
        sprintf(tempStr, "%.2f s", ((float)time_ms) / 1000.0f);
        width = u8g2_GetUTF8Width(&u8g2, tempStr);
        u8g2_DrawStr(&u8g2, (displayWidth - width) / 2, 55, tempStr);
        u8g2_SendBuffer(&u8g2);

        if (xQueueReceive(event_queue, &e, portMAX_DELAY) == pdPASS)
        {
            if (e.type == RE_ET_BTN_CLICKED)
            {
                // Menu Entered
                ESP_LOGI(TAG, "Exit Time Menu");
                AME_CFG_SetTime(time_ms);
                ame_ui_DrawMenuItem(menuIdx);
                break;
            }
            else if (e.type == RE_ET_CHANGED)
            {
                // change time
                time_ms += e.diff * 50;
                if (time_ms < 100)
                {
                    time_ms = 100;
                }
            }
        }
    }
}

static void ame_ui_MenuItemHeight(void)
{
    char tempStr[20];

    rotary_encoder_enable_acceleration(&re, 100);

    for (;;)
    {
        u8g2_ClearBuffer(&u8g2);
        u8g2_SetFont(&u8g2, u8g2_font_ncenB12_tr);
        uint8_t width = u8g2_GetUTF8Width(&u8g2, menuItems[1]);
        u8g2_DrawStr(&u8g2, (displayWidth - width) / 2, 20, menuItems[1]);
        u8g2_SetFont(&u8g2, u8g2_font_ncenB12_tr);
        sprintf(tempStr, "%.1f mm", ((float)caseHeight) / 1000.0f);
        width = u8g2_GetUTF8Width(&u8g2, tempStr);
        u8g2_DrawStr(&u8g2, (displayWidth - width) / 2, 55, tempStr);
        u8g2_SendBuffer(&u8g2);

        if (xQueueReceive(event_queue, &e, portMAX_DELAY) == pdPASS)
        {
            if (e.type == RE_ET_BTN_CLICKED)
            {
                // Menu Entered
                ESP_LOGI(TAG, "Exit Height Menu");
                AME_CFG_SetHeight(caseHeight);
                AME_STEPPER_AdjustHeight();
                ame_ui_DrawMenuItem(menuIdx);
                rotary_encoder_disable_acceleration(&re);
                break;
            }
            else if (e.type == RE_ET_CHANGED)
            {
                // change height
                caseHeight += e.diff * 100;
                if (caseHeight < CONFIG_CHAM_MIN_CASE_LENGTH)
                {
                    caseHeight = CONFIG_CHAM_MIN_CASE_LENGTH;
                }
                else if (caseHeight > CONFIG_CHAM_MAX_CASE_LENGTH)
                {
                    caseHeight = CONFIG_CHAM_MAX_CASE_LENGTH;
                }
            }
        }
    }
}

static void ame_ui_MenuItemCount(void)
{
    char tempStr[20];

    for (;;)
    {
        u8g2_ClearBuffer(&u8g2);
        u8g2_SetFont(&u8g2, u8g2_font_ncenB12_tr);
        uint8_t width = u8g2_GetUTF8Width(&u8g2, menuItems[2]);
        u8g2_DrawStr(&u8g2, (displayWidth - width) / 2, 20, menuItems[2]);
        u8g2_SetFont(&u8g2, u8g2_font_ncenB24_tr);
        sprintf(tempStr, "%d", casesTotal);
        width = u8g2_GetUTF8Width(&u8g2, tempStr);
        u8g2_DrawStr(&u8g2, (displayWidth - width) / 2, 55, tempStr);
        u8g2_SendBuffer(&u8g2);

        if (xQueueReceive(event_queue, &e, portMAX_DELAY) == pdPASS)
        {
            if (e.type == RE_ET_BTN_CLICKED)
            {
                // Menu Entered
                ESP_LOGI(TAG, "Exit Count Menu");
                AME_CFG_SetCasesCount(casesTotal);
                casesRemaining = casesTotal;
                ame_ui_DrawMenuItem(menuIdx);
                break;
            }
            else if (e.type == RE_ET_CHANGED)
            {
                // change time
                casesTotal += e.diff;
                if (casesTotal < 1)
                {
                    casesTotal = 1;
                }
            }
        }
    }
}

static void ame_ui_MenuItemSpeed(void)
{
    char tempStr[20];
    feederSpeed = AME_CFG_GetFeederSpeed();

    for (;;)
    {
        u8g2_ClearBuffer(&u8g2);
        u8g2_SetFont(&u8g2, u8g2_font_ncenB12_tr);
        uint8_t width = u8g2_GetUTF8Width(&u8g2, menuItems[3]);
        u8g2_DrawStr(&u8g2, (displayWidth - width) / 2, 20, menuItems[3]);
        u8g2_SetFont(&u8g2, u8g2_font_ncenB24_tr);
        sprintf(tempStr, "%d", feederSpeed);
        width = u8g2_GetUTF8Width(&u8g2, tempStr);
        u8g2_DrawStr(&u8g2, (displayWidth - width) / 2, 55, tempStr);
        u8g2_SendBuffer(&u8g2);

        if (xQueueReceive(event_queue, &e, portMAX_DELAY) == pdPASS)
        {
            if (e.type == RE_ET_BTN_CLICKED)
            {
                // Menu Entered
                ESP_LOGI(TAG, "Exit Speed Menu");
                AME_CFG_SetFeederSpeed(feederSpeed);
                ame_ui_DrawMenuItem(menuIdx);
                break;
            }
            else if (e.type == RE_ET_CHANGED)
            {
                // change time
                feederSpeed += e.diff;
                if (feederSpeed < 1)
                {
                    feederSpeed = 1;
                }
                else if (feederSpeed > 5)
                {
                    feederSpeed = 5;
                }
            }
        }
    }
}

static void ame_ui_MenuItemVolume(void)
{
    char tempStr[20];
    int8_t volume = AME_CFG_GetStartupTuneVol();

    for (;;)
    {
        u8g2_ClearBuffer(&u8g2);
        u8g2_SetFont(&u8g2, u8g2_font_ncenB12_tr);
        uint8_t width = u8g2_GetUTF8Width(&u8g2, menuItems[4]);
        u8g2_DrawStr(&u8g2, (displayWidth - width) / 2, 20, menuItems[4]);
        u8g2_SetFont(&u8g2, u8g2_font_ncenB24_tr);
        sprintf(tempStr, "%d", volume);
        width = u8g2_GetUTF8Width(&u8g2, tempStr);
        u8g2_DrawStr(&u8g2, (displayWidth - width) / 2, 55, tempStr);
        u8g2_SendBuffer(&u8g2);

        if (xQueueReceive(event_queue, &e, portMAX_DELAY) == pdPASS)
        {
            if (e.type == RE_ET_BTN_CLICKED)
            {
                // Menu Entered
                ESP_LOGI(TAG, "Exit Volume Menu");
                AME_CFG_SetStartupTuneVol(volume);
                ame_ui_DrawMenuItem(menuIdx);
                break;
            }
            else if (e.type == RE_ET_CHANGED)
            {
                // change time
                volume += e.diff;
                if (volume < 0)
                {
                    volume = 0;
                }
                else if (volume > 6)
                {
                    volume = 6;
                }
            }
        }
    }
}

static void ame_ui_MenuItemOta(void)
{
    int8_t subMenuId = 0;
    uint8_t width;
    char tempStrT[20];
    char tempStrM[20];
    char tempStrB[20];
    ota_task_wifi_info_t wifi_info;

    for (;;)
    {
        if (subMenuId == 0)
        {
            if (OTA_TASK_IsStarted() == false)
            {
                snprintf(tempStrM, sizeof(tempStrM), "Start OTA");
                memset(tempStrT, 0, sizeof(tempStrT));
                memset(tempStrB, 0, sizeof(tempStrB));
            }
            else
            {
                OTA_TASK_GetWifiInfo(&wifi_info);
                snprintf(tempStrT, sizeof(tempStrT), "%s", wifi_info.ssid);
                snprintf(tempStrM, sizeof(tempStrM), "%s", wifi_info.password);
                snprintf(tempStrB, sizeof(tempStrB), IPSTR, IP2STR(&wifi_info.ip));
            }
        }
        else if (subMenuId == 1)
        {
            snprintf(tempStrM, sizeof(tempStrM), "Back");
            memset(tempStrT, 0, sizeof(tempStrT));
            memset(tempStrB, 0, sizeof(tempStrB));
        }
        u8g2_ClearBuffer(&u8g2);
        u8g2_SetFont(&u8g2, u8g2_font_ncenB10_tr);
        width = u8g2_GetUTF8Width(&u8g2, tempStrT);
        u8g2_DrawStr(&u8g2, (displayWidth - width) / 2, 20, tempStrT);
        width = u8g2_GetUTF8Width(&u8g2, tempStrM);
        u8g2_DrawStr(&u8g2, (displayWidth - width) / 2, 35, tempStrM);
        width = u8g2_GetUTF8Width(&u8g2, tempStrB);
        u8g2_DrawStr(&u8g2, (displayWidth - width) / 2, 50, tempStrB);
        u8g2_SendBuffer(&u8g2);

        if (xQueueReceive(event_queue, &e, portMAX_DELAY) == pdPASS)
        {
            if (e.type == RE_ET_BTN_CLICKED)
            {
                // Menu Entered
                if ((subMenuId == 0) && !OTA_TASK_IsStarted())
                {
                    ESP_LOGI(TAG, "Start OTA");
                    OTA_TASK_Start();
                }
                else if ((subMenuId == 1) || OTA_TASK_IsStarted())
                {
                    ESP_LOGI(TAG, "Back");
                    ame_ui_DrawMenuItem(menuIdx);
                    break;
                }
            }
            else if (e.type == RE_ET_CHANGED)
            {
                // change time
                subMenuId += e.diff;
                if (subMenuId < 0)
                {
                    subMenuId = 1;
                }
                else if (subMenuId > 1)
                {
                    subMenuId = 0;
                }
            }
        }
    }
}

static void ame_ui_MenuItemInfo(void)
{
    ame_ui_DrawVersion();

    for (;;)
    {
        if (xQueueReceive(event_queue, &e, portMAX_DELAY) == pdPASS)
        {
            if (e.type == RE_ET_BTN_CLICKED)
            {
                // Menu Entered
                ESP_LOGI(TAG, "Exit Info Menu");
                ame_ui_DrawMenuItem(menuIdx);
                break;
            }
            else if (e.type == RE_ET_BTN_LONG_PRESSED)
            {
                ESP_LOGI(TAG, "Hidden tune selection menu");
                ame_ui_TuneSelection();
                break;
            }
        }
    }
}

static void ame_ui_TuneSelection(void)
{
    char tempStr[20];

    int8_t selectedTune = AME_CFG_GetStartupTune();
    int8_t numberOfTunes = AME_BUZZER_GetTuneCount();

    for (;;)
    {
        u8g2_ClearBuffer(&u8g2);
        u8g2_SetFont(&u8g2, u8g2_font_ncenB12_tr);
        uint8_t width = u8g2_GetUTF8Width(&u8g2, "Tune");
        u8g2_DrawStr(&u8g2, (displayWidth - width) / 2, 20, "Tune");
        u8g2_SetFont(&u8g2, u8g2_font_ncenB08_tr);
        AME_BUZZER_GetTuneName(selectedTune, tempStr, sizeof(tempStr));
        width = u8g2_GetUTF8Width(&u8g2, tempStr);
        u8g2_DrawStr(&u8g2, (displayWidth - width) / 2, 55, tempStr);
        u8g2_SendBuffer(&u8g2);

        if (xQueueReceive(event_queue, &e, portMAX_DELAY) == pdPASS)
        {
            if (e.type == RE_ET_BTN_CLICKED)
            {
                // Menu Entered
                ESP_LOGI(TAG, "Exit Info Menu");
                AME_CFG_SetStartupTune(selectedTune);
                ame_ui_DrawMenuItem(menuIdx);
                break;
            }
            else if (e.type == RE_ET_CHANGED)
            {
                // change tune
                selectedTune += e.diff;
                if (selectedTune < 0)
                {
                    selectedTune = numberOfTunes - 1;
                }
                else if (selectedTune > numberOfTunes - 1)
                {
                    selectedTune = 0;
                }
            }
        }
    }
}

static bool ame_ui_ShowStartAnimantion(void)
{
    bool timedOut = true;
    for (uint8_t i = 0; i < FRAME_COUNT; i++)
    {
        u8g2_ClearBuffer(&u8g2);
        u8g2_DrawBitmap(&u8g2, 32, 0, 64 / 8, 64, startAnimation[i]);
        u8g2_SendBuffer(&u8g2);
        if (gpio_get_level(CONFIG_IO_PIN_START_STOP_SWITCH) == 1)
        {
            timedOut = false;
            break;
        }
        vTaskDelay(pdMS_TO_TICKS(1000/FRAME_COUNT));
    }

    return timedOut;
}

static void IRAM_ATTR gpio_isr_handler(void *arg)
{
    uint32_t gpio_num = (uint32_t)arg;
    (void)gpio_num;
    BaseType_t xHigherPriorityTaskWoken;

    /* xHigherPriorityTaskWoken must be initialised to pdFALSE.  If calling
    xTaskNotifyFromISR() unblocks the handling task, and the priority of
    the handling task is higher than the priority of the currently running task,
    then xHigherPriorityTaskWoken will automatically get set to pdTRUE. */
    xHigherPriorityTaskWoken = pdFALSE;

    /* Unblock the handling task so the task can perform any processing necessitated
    by the interrupt.  xHandlingTask is the task's handle, which was obtained
    when the task was created.  The handling task's 0th notification value
    is bitwise ORed with the interrupt status - ensuring bits that are already
    set are not overwritten. */
    xTaskNotifyFromISR(s_display_task_handle,
                        0,
                        eIncrement,
                        &xHigherPriorityTaskWoken);

    /* Force a context switch if xHigherPriorityTaskWoken is now set to pdTRUE.
    The macro used to do this is dependent on the port and may be called
    portEND_SWITCHING_ISR. */
    portYIELD_FROM_ISR(xHigherPriorityTaskWoken);
}

/*************** END OF FUNCTIONS ************************************************************************************/
